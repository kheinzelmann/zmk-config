/* source keypos definitions */
#define CONFIG_WIRELESS
#define MACOS
#define ZMK_BASE_LAYER(name, LT, RT, LM, RM, LB, RB, LH, RH)                   \
    ZMK_LAYER(                                                                 \
        name,                                                                  \
                  LT RT                                                        \
                  LM RM                                                        \
                  LB RB                                                        \
        &bs_del   LH RH &smart_mouse                                        \
    )
#include "zmk-helpers/key-labels/36.h"
#include "base.keymap"

/ { chosen { zmk,matrix_transform = &five_column_transform; }; };
