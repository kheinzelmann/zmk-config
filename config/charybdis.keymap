/* source keypos definitions */
#include "zmk-helpers/key-labels/36.h"
#define CONFIG_WIRELESS
#define MACOS
#define ZMK_BASE_LAYER(name, LT, RT, LM, RM, LB, RB, LH, RH)                   \
    ZMK_LAYER(                                                                 \
        name,                                                                  \
                  LT RT                                                        \
                  LM RM                                                        \
                  LB RB                                                        \
        &bs_del   LH RH                                                        \
    )

#include "base.keymap"

&trackball_listener {
    move {
        layers = <DEF NAV NUM SYS MOUSE>;
        input-processors = <&zip_xy_scaler 1 3>,<&zip_temp_layer MOUSE 750>;
    };

    /* slow mouse in fn layer */
    snipe {
        layers = <FN>;
        input-processors = <&zip_xy_scaler 1 8>;
    };
};