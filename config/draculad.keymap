/* source keypos definitions */
#include "draculad.h"

/* source keypos definitions */
#define CONFIG_WIRELESS
#define MACOS
#define ZMK_BASE_LAYER(name, LT, RT, LM, RM, LB, RB, LH, RH)                   \
    ZMK_LAYER(                                                                 \
        name,                                                                  \
                LT             RT                                              \
                LM             RM                                              \
                LB &none &none RB                                              \
        &bs_del LH             RH &smart_mouse                                 \
    )
#include "base.keymap"
