## config/west.yml
```yaml
manifest:
  defaults:
    remote: urob

  remotes:
    - name: zmkfirmware
      url-base: https://github.com/zmkfirmware
    - name: urob
      url-base: https://github.com/urob
    - name: badjeff
      url-base: https://github.com/badjeff
    - name: caksoylar
      url-base: https://github.com/caksoylar

  projects:
    - name: zmk
      remote: zmkfirmware
      revision: main
      import: app/west.yml
    # modules
    - name: ps2_trackpoint_driver
      repo-path: kb_zmk_ps2_mouse_trackpoint_driver
      remote: badjeff
      revision: main
      path: modules/zmk/ps2_trackpoint_driver
    - name: zmk-adaptive-key
      path: modules/zmk/adaptive-key
      revision: main
    - name: zmk-auto-layer
      path: modules/zmk/auto-layer
      revision: main
    - name: zmk-helpers
      path: modules/zmk/helpers
      revision: main
    - name: zmk-leader-key
      path: modules/zmk/leader-key
      revision: main
    - name: zmk-rgbled-widget
      path: modules/zmk/rgb_widget
      repo-path: zmk-rgbled-widget
      remote: caksoylar
      revision: main
    - name: zmk-tri-state
      path: modules/zmk/tri-state
      revision: main

    # Avoid downloading GBs of unused Zephyr modules. Remove this section to
    # restore the default (needed for less common hardware)
    - name: zephyr
      remote: zmkfirmware
      revision: v4.1.0+zmk-fixes
      clone-depth: 1
      import:
        name-allowlist:
          - cmsis
          - hal_nordic
          - hal_rpi_pico
          - hal_stm32
          - lvgl
          - mbedtls
          - tinycrypt

  self:
    path: config
```
