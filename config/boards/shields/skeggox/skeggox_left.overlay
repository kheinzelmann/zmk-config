/*
 * Copyright (c) 2021 The ZMK Contributors
 *
 * SPDX-License-Identifier: MIT
 */

#include "skeggox.dtsi"

&kscan0 {
    row-gpios
        = <&xiao_d  1 (GPIO_ACTIVE_HIGH | GPIO_PULL_DOWN)>
        , <&xiao_d  2 (GPIO_ACTIVE_HIGH | GPIO_PULL_DOWN)>
        , <&xiao_d  3 (GPIO_ACTIVE_HIGH | GPIO_PULL_DOWN)>
        , <&xiao_d  4 (GPIO_ACTIVE_HIGH | GPIO_PULL_DOWN)>
        ;
    col-gpios
        = <&xiao_d 10 GPIO_ACTIVE_HIGH>
        , <&xiao_d  9 GPIO_ACTIVE_HIGH>
        , <&xiao_d  8 GPIO_ACTIVE_HIGH>
        , <&xiao_d  7 GPIO_ACTIVE_HIGH>
        , <&xiao_d  0 GPIO_ACTIVE_HIGH>
        ;
};



// reset pin (this is either 9 or 10)
#define MOUSE_PS2_PIN_RST <&gpio0 9 GPIO_ACTIVE_HIGH>

// define the trackpoint
#include "tp_ps2.dtsi"

&tpoint_peripheral_listener{ status = "okay"; };
&tpoint_central_listener { device = <&tpoint0>; status = "okay"; };
