## config/boards/shields/skeggox/Kconfig.defconfig
```kconfig
# Copyright (c) 2021 The ZMK Contributors
# SPDX-License-Identifier: MIT

if SHIELD_SKEGGOX_LEFT

config ZMK_KEYBOARD_NAME
	default "skeggox"

config ZMK_SPLIT_ROLE_CENTRAL
	default y

endif

if SHIELD_SKEGGOX_LEFT || SHIELD_SKEGGOX_RIGHT

config ZMK_SPLIT
	default y

endif
```

## config/boards/shields/skeggox/Kconfig.shield
```kconfig
# Copyright (c) 2021 The ZMK Contributors
# SPDX-License-Identifier: MIT

config SHIELD_SKEGGOX_LEFT
	def_bool $(shields_list_contains,skeggox_left)

config SHIELD_SKEGGOX_RIGHT
	def_bool $(shields_list_contains,skeggox_right)
```
